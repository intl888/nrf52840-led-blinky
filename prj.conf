## CMakeLists.txt
```
cmake_minimum_required(VERSION 3.20.0)
set(BOARD nrf52840dk_nrf52840)
find_package(Zephyr REQUIRED HINTS $ENV{ZEPHYR_BASE})

project(led_blinky_project)

target_sources(app PRIVATE src/main.c)
set(CMAKE_BUILD_TYPE Debug)
```

## west.yml
```
manifest:
  remotes:
    - name: ncs
      url-base: https://github.com/nrfconnect
  projects:
    - name: nrf
      path: nrf
      remote: ncs
      revision: v2.6.1  # Use the version of your installed SDK
      import: true
  self:
    path: application
```

## prj.conf
```kconfig
# Enable GPIO
CONFIG_GPIO=y

# Additional recommended configurations for LED blinking
CONFIG_SERIAL=y
CONFIG_CONSOLE=y
CONFIG_UART_CONSOLE=y
```

## src/main.c
```c
#include <zephyr/kernel.h>  // Include Zephyr kernel header for kernel related functions and definitions
#include <zephyr/drivers/gpio.h>  // Include Zephyr GPIO driver header for GPIO functions and definitions

/* Define LED0_NODE as the devicetree node identifier for the "led0" alias. */
#define LED0_NODE DT_ALIAS(led0)

/*
 * A build error on this line means your board is unsupported.
 * See the sample documentation for information on how to fix this.
 */
static const struct gpio_dt_spec led = GPIO_DT_SPEC_GET(LED0_NODE, gpios);

void main(void)
{
    int ret;

    if (!device_is_ready(led.port)) {
        return;
    }

    ret = gpio_pin_configure_dt(&led, GPIO_OUTPUT_ACTIVE);
    if (ret < 0) {
        return;
    }

    while (1) {
        ret = gpio_pin_toggle_dt(&led);
        if (ret < 0) {
            return;
        }
        k_msleep(1000);
    }
}
```
